#include "battery/batterydata.dtsi"
#include "panel/panel.dtsi"
#include "camera.dtsi"
#include "input.dtsi"
#include "pinctrl.dtsi"
#include "pmi.dtsi"
#include "regulator.dtsi"
#include "soc.dtsi"
#include "thermals.dtsi"