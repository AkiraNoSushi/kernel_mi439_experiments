&spi_6 {
    spi-max-frequency = <50000000>;
    clocks = <&clock_gcc clk_gcc_blsp2_ahb_clk>,
        <&clock_gcc clk_gcc_blsp2_qup2_spi_apps_clk>;
};

&soc {
    /delete-node/ blsp2_uart2;
    /delete-node/ i2c_4;

    aliases {
        /delete-property/ i2c4;
    };

    simtray {
		compatible = "xiaomi,simtray-status";
		status-gpio = <&tlmm 54 0x00>;
	};
};
