/dts-v1/;
/plugin/;

#include "msm8937-interposer-sdm439.dtsi"
#include "sdm439.dtsi"
#include "sdm439-qrd.dtsi"


#include "xiaomi/xiaomi.dtsi"
#include "xiaomi/olives/olives.dtsi"

/ {
	model = "Olive QRD";
	qcom,board-id = <0xb 8>;
	qcom,pmic-id = <0x010016 0x25 0x8 0x0>;
};
